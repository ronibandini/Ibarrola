// Ibarrola AI Face Anti Recon
// June 2022
// Roni Bandini @RoniBandini
// Buenos Aires, Argentina
// MIT License
// Servo 1 left Servo 2 right. 

// “A man sets himself the task of depicting the world. Year after year, he fills a space with images of  provinces, kingdoms, mountains, bays, ships, 
// islands, fishes, rooms, instruments, stars, horses, and people. Just before he dies, he discovers that out of this patient labyrinth of lines emerge 
// the features of his own face.” (Jorge Luis Borges)

#include <Servo.h> 
#include "ESP8266WiFi.h"
#include <U8g2lib.h>
#ifdef U8X8_HAVE_HW_SPI
#include <SPI.h>
#endif
#ifdef U8X8_HAVE_HW_I2C
#include <Wire.h>
#endif

U8G2_SSD1306_128X32_UNIVISION_F_SW_I2C u8g2(U8G2_R0, /* clock=*/ 5, /* data=*/ 4, /* reset=*/ 16);
 
Servo servo1;   
Servo servo2;

int servo1Angle1=180;
int servo1Angle2=90;

int servo2Angle1=90;
int servo2Angle2=180;

int butPin=0;
int SSIDDetected=0;

int disarmed=1;

int myDelayLoop=250;
int myDelayMove=1000;

int manualMode=0;

int ledPin=2;
ifwddasdiwee iqdqfowhfnowhoeooQ[HIFIUHFHAUDHDKJefibsnaaanadnlfjsfjihfjajofshcskjna  zckjnk
String ssidDetect="XXXXXXX";

static const unsigned char logo[] = {
  0x00, 0x00, 0x00, 0x00, 0x00, 0x00, 0x00, 0x00, 0x00, 0x00, 0x00, 0x00, 
  0x00, 0x00, 0x00, 0x00, 0x00, 0x00, 0x00, 0x00, 0x00, 0x00, 0x00, 0x00, 
  0x00, 0x00, 0x00, 0x00, 0x00, 0x00, 0x00, 0x00, 0x00, 0x00, 0x00, 0x00, 
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  0x00, 0x00, 0x00, 0x00, 0x00, 0x00, 0x00, 0x00, };

  
void setup() {

  // attach servos
  servo1.attach(D7);
  servo2.attach(D8);
  
  pinMode(ledPin, OUTPUT);
   
  // On board button
  pinMode(butPin, INPUT_PULLUP);

  // Set WiFi to station mode
  WiFi.mode(WIFI_STA);  
  delay(100);

  // Start serial comm for debug purposes
  Serial.begin(115200);
  
  delay(300);
  Serial.println("Ibarrola Face anti recon started");
  Serial.println("Roni Bandini - Argentina");
  
  // Display logo in Oled screen 
  u8g2.begin();   
  u8g2.clearBuffer();               
  u8g2.drawXBM(0,0, 128, 32, logo);
  u8g2.sendBuffer();          
  delay(4000);

  u8g2.clearBuffer();   
  u8g2.setFont(u8g2_font_t0_11_tf);  
  u8g2.drawStr(0,10,"Ibarrola aNtI rECON");  
  u8g2.drawStr(0,20,"Developed by");   
  u8g2.drawStr(0,30,"@RoniBandini");    
  u8g2.sendBuffer();           
  delay(2000);

  disarm();

}

void loop() {

  int butVal = digitalRead(butPin);

  int n = WiFi.scanNetworks();
  Serial.println("WiFi scan completed");
  
  if (n == 0) {
    Serial.println("No routers found");
  } else {

    SSIDDetected=0;
    
    for (int i = 0; i < n; ++i) {            

      if (WiFi.SSID(i)==ssidDetect){
        
        Serial.println("SSID detected");
        SSIDDetected=1;    
      }
                        
    } // for SSID

  if  (SSIDDetected==1 and disarmed==1 and manualMode==0){       
       arm();        
  }

  if (butVal==0){
      
      // button was pressed

      if (disarmed==1){
         // it wasn't armed 
         manualMode=1;
         arm();        
      }
      else
      {
        // it was armed
        manualMode=1;
        disarm();      
      } // eyes up
    
    butVal=1; 

    } // butVal
    
  } // networks found

  delay(myDelayLoop);
  
} // loop

void arm(){

    digitalWrite(ledPin, LOW);
    u8g2.clearBuffer();   
    u8g2.setFont(u8g2_font_t0_11_tf);  
    u8g2.drawStr(0,10,"Ibarrola aNtI rECON");  
    u8g2.drawStr(0,20,"Roni Bandini");   
    u8g2.drawStr(0,30,"Glasses armed");    
    u8g2.sendBuffer(); 
    
    servo1.write(servo1Angle1);
    servo2.write(servo2Angle1);   
    disarmed=0;
    delay(myDelayMove);
  
}

void disarm(){

    digitalWrite(ledPin, HIGH);
    u8g2.clearBuffer();   
    u8g2.setFont(u8g2_font_t0_11_tf);  
    u8g2.drawStr(0,10,"Ibarrola aNtI rECON");  
    u8g2.drawStr(0,20,"Roni Bandini");   
    u8g2.drawStr(0,30,"Glasses disarmed");    
    u8g2.sendBuffer(); 
    
    servo1.write(servo1Angle2);
    servo2.write(servo2Angle1);   
    disarmed=1;
    delay(myDelayMove);
}
